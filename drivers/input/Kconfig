## drivers/input/Kconfig
```kconfig
config INPUT_TPS43
    bool "Azoteq TPS43 I2C Touchpad Input Device"
    default y
    depends on DT_HAS_AZOTEQ_TPS43_ENABLED
    depends on I2C
    depends on INPUT
    help
      Enable driver for Azoteq touchpad input device over I2C interface.
      Supports multitouch gestures, scrolling, clicks and power management.

DT_COMPAT_ZMK_BEHAVIOR_TPS43_SOFT_RESET := zmk,behavior-tps43-soft-reset

config INPUT_TPS43_SOFT_RESET
    bool "TPS43 global input-state soft reset behavior"
    default $(dt_compat_enabled,$(DT_COMPAT_ZMK_BEHAVIOR_TPS43_SOFT_RESET))
    help
      Enable the zmk,behavior-tps43-soft-reset behavior: one keymap binding
      releases stuck keymap positions, flushes HID reports and cancels the
      leader-key sequence on the central, stops the mouse mover and resets
      layers to default, and re-initializes the TPS43 chip on the half that
      owns it. Must build on BOTH split roles (the global-locality binding
      needs a local handler wherever the behavior node is enabled), so it
      deliberately does not depend on INPUT_TPS43.
```

## dts/bindings/behaviors/zmk,behavior-tps43-soft-reset.yaml
```yaml
# Global soft-reset behavior for the Azoteq TPS43 trackpad stack

description: |
  Full input-state soft reset. One press runs on every firmware in the
  split pair (global locality): releases all stuck keymap positions, clears
  and sends the keyboard/consumer/mouse HID reports, cancels any pending
  leader-key sequence. On the central it also stops the mouse mover and
  returns the layer tree to the default layer; on the peripheral owning the
  TPS43 it re-initializes the trackpad chip (hardware RST pulse, full
  re-configuration, RDY IRQ re-arm). No reboot, BLE stays connected.

compatible: "zmk,behavior-tps43-soft-reset"

include: zero_param.yaml
```
